## config/west.yml
```yaml
manifest:
  defaults:
    revision: 4dd95d7840eb3d5a3f59bb29fbf1ab054715ef85
  remotes:
    - name: zmkfirmware
      url-base: https://github.com/zmkfirmware
    # Additional modules containing boards/shields/custom code can be listed here as well
    # See https://docs.zephyrproject.org/3.2.0/develop/west/manifest.html#projects
  projects:
    - name: zmk
      remote: zmkfirmware
      import: app/west.yml
    - name: cirque-input-module
      url: https://github.com/Riq137/cirque-input-module
      revision: a577f0329d7d386c90abf35f1b7d9cbfa7b153a2
      path: modules/cirque-input-module
  self:
    path: config
```
